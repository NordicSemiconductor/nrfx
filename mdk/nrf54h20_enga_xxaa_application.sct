LOAD 0x1E0A0000 0x00040000
{
    FLASH0 0x1E0A0000 0x00040000
    {
    *.o (RESET, +First)   ; RESET is code section with I.V.T.
        * (InRoot$$Sections)
        .ANY (+RO)
        .ANY (+XO)
    }

    FLASH1 0x0E0A0000 0x00040000
    {
    
        .ANY (+RO)
        .ANY (+XO)
    }

    FLASH2 0x3F840000 0x00004000
    {
    
        .ANY (+RO)
        .ANY (+XO)
    }

    FLASH3 0x2F840000 0x00004000
    {
    
        .ANY (+RO)
        .ANY (+XO)
    }
    EXT_FLASH 0x70000000 0x20000000
    {
    .ANY (ext_flash) ; Data or code allocated to external memory 
    }
    RAM0 0x32000000 0x00008000
    {
    .ANY(+RW, +ZI) ; RW data and ZI data
    }

    RAM1 0x22000000 0x00008000
    {
    .ANY(+RW, +ZI) ; RW data and ZI data
    }

    RAM2 0x3F000000 0x00080000
    {
    .ANY(+RW, +ZI) ; RW data and ZI data
    }

    RAM3 0x2F000000 0x00080000
    {
    .ANY(+RW, +ZI) ; RW data and ZI data
    }

    RAM4 0x3F080000 0x00060000
    {
    .ANY(+RW, +ZI) ; RW data and ZI data
    }

    RAM5 0x2F080000 0x00060000
    {
    .ANY(+RW, +ZI) ; RW data and ZI data
    }

    RAM6 0x3FBF0000 0x00008000
    {
    .ANY(+RW, +ZI) ; RW data and ZI data
    }

    RAM7 0x2FBF0000 0x00008000
    {
    .ANY(+RW, +ZI) ; RW data and ZI data
    }

    RAM8 0x3FBF8000 0x00008000
    {
    .ANY(+RW, +ZI) ; RW data and ZI data
    }

    RAM9 0x2FBF8000 0x00008000
    {
    .ANY(+RW, +ZI) ; RW data and ZI data
    }

    RAM10 0x3FC00000 0x00004000
    {
    .ANY(+RW, +ZI) ; RW data and ZI data
    }

    RAM11 0x2FC00000 0x00004000
    {
    .ANY(+RW, +ZI) ; RW data and ZI data
    }

    RAM12 0x3FC04000 0x00004000
    {
    .ANY(+RW, +ZI) ; RW data and ZI data
    }

    RAM13 0x2FC04000 0x00004000
    {
    .ANY(+RW, +ZI) ; RW data and ZI data
    }

}