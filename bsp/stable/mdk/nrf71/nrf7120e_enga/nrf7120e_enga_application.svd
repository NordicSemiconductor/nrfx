# nrf7120E_enga_application register map
Vendor: Nordic Semiconductor; Series: nrf71; File version: 1
System-on-chip with a 32-bit Arm Cortex-M33 microcontroller
CPU: CM33 r0p4, little endian, MPU, FPU, 3 interrupt priority bits, 270 interrupts, 4 SAU regions
Registers are 32-bit, read-write, reset 0x0 unless marked. A register's access mark holds for its fields unless they carry their own. Offsets are from the block's base; lines under a group give offsets from that group; [hi:lo] are bit positions; {n}, {i} and the like mark numbered series; 'fields as' and 'values as' point back to an identical list; <NAME> marks a mode.

## Memory map
0x003FD000 GLOBAL_WICR_NS size 0x1000 — Wi-Fi Information Configuration Registers
0x00FFC000 GLOBAL_FICR_NS size 0x1000 — Factory Information Configuration Registers
0x00FFD000 GLOBAL_UICR_S size 0x1000 — User Information Configuration Registers
0x00FFE000 GLOBAL_SICR_S size 0x1000 — Factory Information Configuration Registers
0x40020000 GLOBAL_USBHSCORE_NS size 0x24000 — USBHSCORE 0
0x40042000 GLOBAL_DPPIC00_NS size 0x1000 — Distributed programmable peripheral interconnect controller 0
0x40044000 GLOBAL_PPIB00_NS size 0x1000 — PPIB APB registers 0
0x40045000 GLOBAL_PPIB01_NS size 0x1000 — PPIB APB registers 2
0x4004A000 GLOBAL_AAR00_NS size 0x1000 — Accelerated Address Resolver 0
0x4004A000 GLOBAL_CCM00_NS size 0x1000 — AES CCM Mode Encryption 0
0x4004B000 GLOBAL_ECB00_NS size 0x1000 — AES ECB Mode Encryption 0
0x4004C000 GLOBAL_VPR00_NS size 0x1000 — VPR peripheral registers 0
0x4004D000 GLOBAL_SPIM00_NS size 0x1000 — Serial Peripheral Interface Master with EasyDMA 0
0x4004D000 GLOBAL_SPIS00_NS size 0x1000 — SPI Slave 0
0x4004D000 GLOBAL_UARTE00_NS size 0x1000 — UART with EasyDMA 0
0x40050400 GLOBAL_P2_NS size 0x200 — GPIO Port 0
0x40052000 GLOBAL_CTRLAP_NS size 0x1000 — Control access port 0
0x40053000 GLOBAL_TAD_NS size 0x1000 — Trace and debug control 0
0x40055000 GLOBAL_TIMER00_NS size 0x1000 — Timer/Counter 0
0x40056000 GLOBAL_AXONS_NS size 0x1000 — Neural processing unit (NPU) 0
0x40058000 GLOBAL_EGU00_NS size 0x1000 — Event generator unit 0
0x4005A000 GLOBAL_USBHS_NS size 0x1000 — USBHS 0
0x4005B000 GLOBAL_MSPI00_NS size 0x1000 — Multi serial peripheral interface 0
0x4005C000 GLOBAL_MSPI01_NS size 0x1000 — Multi serial peripheral interface 2
0x4005D000 GLOBAL_SPIM01_NS size 0x1000 — Serial Peripheral Interface Master with EasyDMA 2
0x4005D000 GLOBAL_SPIS01_NS size 0x1000 — SPI Slave 2
0x40078000 BELLBOARD_NS size 0x1000 — BELLBOARD APB registers
0x40082000 GLOBAL_DPPIC10_NS size 0x1000 — Distributed programmable peripheral interconnect controller 2
0x40083000 GLOBAL_PPIB10_NS size 0x1000 — PPIB APB registers 4
0x40084000 GLOBAL_PPIB11_NS size 0x1000 — PPIB APB registers 6
0x40085000 GLOBAL_TIMER10_NS size 0x1000 — Timer/Counter 2
0x40087000 GLOBAL_EGU10_NS size 0x1000 — Event generator unit 2
0x4008A000 GLOBAL_RADIO_NS size 0x2000 — 2.4 GHz radio 0
0x4008D000 GLOBAL_IPCT10_NS size 0x1000 — IPCT APB registers 0
0x400C2000 GLOBAL_DPPIC20_NS size 0x1000 — Distributed programmable peripheral interconnect controller 4
0x400C3000 GLOBAL_PPIB20_NS size 0x1000 — PPIB APB registers 8
0x400C4000 GLOBAL_PPIB21_NS size 0x1000 — PPIB APB registers 10
0x400C5000 GLOBAL_PPIB22_NS size 0x1000 — PPIB APB registers 12
0x400C6000 GLOBAL_SPIM20_NS size 0x1000 — Serial Peripheral Interface Master with EasyDMA 4
0x400C6000 GLOBAL_SPIS20_NS size 0x1000 — SPI Slave 4
0x400C6000 GLOBAL_TWIM20_NS size 0x1000 — I2C compatible Two-Wire Master Interface with EasyDMA 0
0x400C6000 GLOBAL_TWIS20_NS size 0x1000 — I2C compatible Two-Wire Slave Interface with EasyDMA 0
0x400C6000 GLOBAL_UARTE20_NS size 0x1000 — UART with EasyDMA 2
0x400C7000 GLOBAL_SPIM21_NS size 0x1000 — Serial Peripheral Interface Master with EasyDMA 6
0x400C7000 GLOBAL_SPIS21_NS size 0x1000 — SPI Slave 6
0x400C7000 GLOBAL_TWIM21_NS size 0x1000 — I2C compatible Two-Wire Master Interface with EasyDMA 2
0x400C7000 GLOBAL_TWIS21_NS size 0x1000 — I2C compatible Two-Wire Slave Interface with EasyDMA 2
0x400C7000 GLOBAL_UARTE21_NS size 0x1000 — UART with EasyDMA 4
0x400C8000 GLOBAL_SPIM22_NS size 0x1000 — Serial Peripheral Interface Master with EasyDMA 8
0x400C8000 GLOBAL_SPIS22_NS size 0x1000 — SPI Slave 8
0x400C8000 GLOBAL_TWIM22_NS size 0x1000 — I2C compatible Two-Wire Master Interface with EasyDMA 4
0x400C8000 GLOBAL_TWIS22_NS size 0x1000 — I2C compatible Two-Wire Slave Interface with EasyDMA 4
0x400C8000 GLOBAL_UARTE22_NS size 0x1000 — UART with EasyDMA 6
0x400C9000 GLOBAL_EGU20_NS size 0x1000 — Event generator unit 4
0x400CA000 GLOBAL_TIMER20_NS size 0x1000 — Timer/Counter 4
0x400CB000 GLOBAL_TIMER21_NS size 0x1000 — Timer/Counter 6
0x400CC000 GLOBAL_TIMER22_NS size 0x1000 — Timer/Counter 8
0x400CD000 GLOBAL_TIMER23_NS size 0x1000 — Timer/Counter 10
0x400CE000 GLOBAL_TIMER24_NS size 0x1000 — Timer/Counter 12
0x400CF000 GLOBAL_MEMCONF_NS size 0x1000 — Memory configuration 0
0x400D0000 GLOBAL_PDM20_NS size 0x1000 — Pulse Density Modulation (Digital Microphone) Interface 0
0x400D1000 GLOBAL_PDM21_NS size 0x1000 — Pulse Density Modulation (Digital Microphone) Interface 2
0x400D2000 GLOBAL_PWM20_NS size 0x1000 — Pulse width modulation unit 0
0x400D3000 GLOBAL_PWM21_NS size 0x1000 — Pulse width modulation unit 2
0x400D4000 GLOBAL_PWM22_NS size 0x1000 — Pulse width modulation unit 4
0x400D5000 GLOBAL_SAADC_NS size 0x1000 — Analog to Digital Converter 0
0x400D6000 GLOBAL_NFCT_NS size 0x1000 — NFC-A compatible radio NFC-A compatible radio 0
0x400D7000 GLOBAL_TEMP_NS size 0x1000 — Temperature Sensor 0
0x400D8200 GLOBAL_P1_NS size 0x200 — GPIO Port 2
0x400D8600 GLOBAL_P3_NS size 0x200 — GPIO Port 3
0x400D8800 GLOBAL_P4_NS size 0x200 — GPIO Port 4
0x400DA000 GLOBAL_GPIOTE20_NS size 0x1000 — GPIO Tasks and Events 0
0x400E0000 GLOBAL_QDEC20_NS size 0x1000 — Quadrature Decoder 0
0x400E1000 GLOBAL_QDEC21_NS size 0x1000 — Quadrature Decoder 2
0x400E2000 GLOBAL_GRTC_NS size 0x1000 — Global Real-time counter 0
0x400E8000 GLOBAL_TDM_NS size 0x1000 — Time division multiplexed audio interface 0
0x400ED000 GLOBAL_SPIM23_NS size 0x1000 — Serial Peripheral Interface Master with EasyDMA 10
0x400ED000 GLOBAL_SPIS23_NS size 0x1000 — SPI Slave 10
0x400ED000 GLOBAL_TWIM23_NS size 0x1000 — I2C compatible Two-Wire Master Interface with EasyDMA 6
0x400ED000 GLOBAL_TWIS23_NS size 0x1000 — I2C compatible Two-Wire Slave Interface with EasyDMA 6
0x400ED000 GLOBAL_UARTE23_NS size 0x1000 — UART with EasyDMA 8
0x400EE000 GLOBAL_SPIM24_NS size 0x1000 — Serial Peripheral Interface Master with EasyDMA 12
0x400EE000 GLOBAL_SPIS24_NS size 0x1000 — SPI Slave 12
0x400EE000 GLOBAL_TWIM24_NS size 0x1000 — I2C compatible Two-Wire Master Interface with EasyDMA 8
0x400EE000 GLOBAL_TWIS24_NS size 0x1000 — I2C compatible Two-Wire Slave Interface with EasyDMA 8
0x400EE000 GLOBAL_UARTE24_NS size 0x1000 — UART with EasyDMA 10
0x400F1000 GLOBAL_COEXC_NS size 0x1000 — Coexistence controller 0
0x40102000 GLOBAL_DPPIC30_NS size 0x1000 — Distributed programmable peripheral interconnect controller 6
0x40103000 GLOBAL_PPIB30_NS size 0x1000 — PPIB APB registers 14
0x40104000 GLOBAL_SPIM30_NS size 0x1000 — Serial Peripheral Interface Master with EasyDMA 14
0x40104000 GLOBAL_SPIS30_NS size 0x1000 — SPI Slave 14
0x40104000 GLOBAL_TWIM30_NS size 0x1000 — I2C compatible Two-Wire Master Interface with EasyDMA 10
0x40104000 GLOBAL_TWIS30_NS size 0x1000 — I2C compatible Two-Wire Slave Interface with EasyDMA 10
0x40104000 GLOBAL_UARTE30_NS size 0x1000 — UART with EasyDMA 12
0x40106000 GLOBAL_COMP_NS size 0x1000 — Comparator 0
0x40106000 GLOBAL_LPCOMP_NS size 0x1000 — Low-power comparator 0
0x40109000 GLOBAL_WDT31_NS size 0x1000 — Watchdog Timer 1
0x4010A000 GLOBAL_P0_NS size 0x200 — GPIO Port 8
0x4010C000 GLOBAL_GPIOTE30_NS size 0x1000 — GPIO Tasks and Events 2
0x4010E000 GLOBAL_CLOCK_NS size 0x1000 — Clock management 0
0x4010E000 GLOBAL_POWER_NS size 0x1000 — Power control 0
0x4010E000 GLOBAL_RESET_NS size 0x1000 — Reset control 0
0x40120000 GLOBAL_OSCILLATORS_NS size 0x1000 — Oscillator control 0
0x40120000 GLOBAL_REGULATORS_NS size 0x1000 — Voltage regulators 0
0x40121000 GLOBAL_VREGUSB_NS size 0x1000 — VREGUSB peripheral 0
0x40122000 GLOBAL_LFXO_NS size 0x1000 — LFXO peripheral 0
0x40123000 GLOBAL_LFRC_NS size 0x1000 — LFRC peripheral 0
0x40124000 GLOBAL_HFXO64M_NS size 0x1000 — HFXO64M peripheral 0
0x4012A000 GLOBAL_OSCRFR_NS size 0x1000 — OSCRFR peripheral 0
0x40130000 GLOBAL_AUXPLL_NS size 0x1000 — AUXPLL 0
0x40130000 GLOBAL_AUXPM_NS size 0x1000 — AUXPM 0
0x50010000 GLOBAL_CRACENCORE_S size 0x1000 — CRACENCORE
0x5001C000 SWI00_S size 0x1000 — Software interrupt 0
0x5001D000 SWI01_S size 0x1000 — Software interrupt 1
0x5001E000 SWI02_S size 0x1000 — Software interrupt 2
0x5001F000 SWI03_S size 0x1000 — Software interrupt 3
0x50020000 GLOBAL_USBHSCORE_S size 0x24000 — USBHSCORE 1
0x50040000 GLOBAL_SPU00_S size 0x1000 — System protection unit 0
0x50041000 GLOBAL_MPC00_S size 0x1000 — Memory Privilege Controller 0
0x50042000 GLOBAL_DPPIC00_S size 0x1000 — Distributed programmable peripheral interconnect controller 1
0x50043000 GLOBAL_MPC03_S size 0x1000 — Memory Privilege Controller 1
0x50044000 GLOBAL_PPIB00_S size 0x1000 — PPIB APB registers 1
0x50045000 GLOBAL_PPIB01_S size 0x1000 — PPIB APB registers 3
0x50049000 GLOBAL_KMU_S size 0x1000 — Key management unit
0x5004A000 GLOBAL_AAR00_S size 0x1000 — Accelerated Address Resolver 1
0x5004A000 GLOBAL_CCM00_S size 0x1000 — AES CCM Mode Encryption 1
0x5004B000 GLOBAL_ECB00_S size 0x1000 — AES ECB Mode Encryption 1
0x5004C000 GLOBAL_VPR00_S size 0x1000 — VPR peripheral registers 1
0x5004D000 GLOBAL_SPIM00_S size 0x1000 — Serial Peripheral Interface Master with EasyDMA 1
0x5004D000 GLOBAL_SPIS00_S size 0x1000 — SPI Slave 1
0x5004D000 GLOBAL_UARTE00_S size 0x1000 — UART with EasyDMA 1
0x5004E000 GLOBAL_MRAMC_S size 0x1000 — MRAM controller
0x50050400 GLOBAL_GPIOHSPADCTRL_S size 0x1000 — GPIO high-speed pad control
0x50050400 GLOBAL_P2_S size 0x200 — GPIO Port 1
0x50052000 GLOBAL_CTRLAP_S size 0x1000 — Control access port 1
0x50053000 GLOBAL_TAD_S size 0x1000 — Trace and debug control 1
0x50055000 GLOBAL_TIMER00_S size 0x1000 — Timer/Counter 1
0x50056000 GLOBAL_AXONS_S size 0x1000 — Neural processing unit (NPU) 1
0x50058000 GLOBAL_EGU00_S size 0x1000 — Event generator unit 1
0x50059000 GLOBAL_CRACEN_S size 0x1000 — CRACEN
0x5005A000 GLOBAL_USBHS_S size 0x1000 — USBHS 1
0x5005B000 GLOBAL_MSPI00_S size 0x1000 — Multi serial peripheral interface 1
0x5005C000 GLOBAL_MSPI01_S size 0x1000 — Multi serial peripheral interface 3
0x5005D000 GLOBAL_SPIM01_S size 0x1000 — Serial Peripheral Interface Master with EasyDMA 3
0x5005D000 GLOBAL_SPIS01_S size 0x1000 — SPI Slave 3
0x50080000 GLOBAL_SPU10_S size 0x1000 — System protection unit 1
0x50082000 GLOBAL_DPPIC10_S size 0x1000 — Distributed programmable peripheral interconnect controller 3
0x50083000 GLOBAL_PPIB10_S size 0x1000 — PPIB APB registers 5
0x50084000 GLOBAL_PPIB11_S size 0x1000 — PPIB APB registers 7
0x50085000 GLOBAL_TIMER10_S size 0x1000 — Timer/Counter 3
0x50087000 GLOBAL_EGU10_S size 0x1000 — Event generator unit 3
0x5008A000 GLOBAL_RADIO_S size 0x2000 — 2.4 GHz radio 1
0x5008D000 GLOBAL_IPCT10_S size 0x1000 — IPCT APB registers 1
0x500C0000 GLOBAL_SPU20_S size 0x1000 — System protection unit 2
0x500C2000 GLOBAL_DPPIC20_S size 0x1000 — Distributed programmable peripheral interconnect controller 5
0x500C3000 GLOBAL_PPIB20_S size 0x1000 — PPIB APB registers 9
0x500C4000 GLOBAL_PPIB21_S size 0x1000 — PPIB APB registers 11
0x500C5000 GLOBAL_PPIB22_S size 0x1000 — PPIB APB registers 13
0x500C6000 GLOBAL_SPIM20_S size 0x1000 — Serial Peripheral Interface Master with EasyDMA 5
0x500C6000 GLOBAL_SPIS20_S size 0x1000 — SPI Slave 5
0x500C6000 GLOBAL_TWIM20_S size 0x1000 — I2C compatible Two-Wire Master Interface with EasyDMA 1
0x500C6000 GLOBAL_TWIS20_S size 0x1000 — I2C compatible Two-Wire Slave Interface with EasyDMA 1
0x500C6000 GLOBAL_UARTE20_S size 0x1000 — UART with EasyDMA 3
0x500C7000 GLOBAL_SPIM21_S size 0x1000 — Serial Peripheral Interface Master with EasyDMA 7
0x500C7000 GLOBAL_SPIS21_S size 0x1000 — SPI Slave 7
0x500C7000 GLOBAL_TWIM21_S size 0x1000 — I2C compatible Two-Wire Master Interface with EasyDMA 3
0x500C7000 GLOBAL_TWIS21_S size 0x1000 — I2C compatible Two-Wire Slave Interface with EasyDMA 3
0x500C7000 GLOBAL_UARTE21_S size 0x1000 — UART with EasyDMA 5
0x500C8000 GLOBAL_SPIM22_S size 0x1000 — Serial Peripheral Interface Master with EasyDMA 9
0x500C8000 GLOBAL_SPIS22_S size 0x1000 — SPI Slave 9
0x500C8000 GLOBAL_TWIM22_S size 0x1000 — I2C compatible Two-Wire Master Interface with EasyDMA 5
0x500C8000 GLOBAL_TWIS22_S size 0x1000 — I2C compatible Two-Wire Slave Interface with EasyDMA 5
0x500C8000 GLOBAL_UARTE22_S size 0x1000 — UART with EasyDMA 7
0x500C9000 GLOBAL_EGU20_S size 0x1000 — Event generator unit 5
0x500CA000 GLOBAL_TIMER20_S size 0x1000 — Timer/Counter 5
0x500CB000 GLOBAL_TIMER21_S size 0x1000 — Timer/Counter 7
0x500CC000 GLOBAL_TIMER22_S size 0x1000 — Timer/Counter 9
0x500CD000 GLOBAL_TIMER23_S size 0x1000 — Timer/Counter 11
0x500CE000 GLOBAL_TIMER24_S size 0x1000 — Timer/Counter 13
0x500CF000 GLOBAL_MEMCONF_S size 0x1000 — Memory configuration 1
0x500D0000 GLOBAL_PDM20_S size 0x1000 — Pulse Density Modulation (Digital Microphone) Interface 1
0x500D1000 GLOBAL_PDM21_S size 0x1000 — Pulse Density Modulation (Digital Microphone) Interface 3
0x500D2000 GLOBAL_PWM20_S size 0x1000 — Pulse width modulation unit 1
0x500D3000 GLOBAL_PWM21_S size 0x1000 — Pulse width modulation unit 3
0x500D4000 GLOBAL_PWM22_S size 0x1000 — Pulse width modulation unit 5
0x500D5000 GLOBAL_SAADC_S size 0x1000 — Analog to Digital Converter 1
0x500D6000 GLOBAL_NFCT_S size 0x1000 — NFC-A compatible radio NFC-A compatible radio 1
0x500D7000 GLOBAL_TEMP_S size 0x1000 — Temperature Sensor 1
0x500D8200 GLOBAL_P1_S size 0x200 — GPIO Port 5
0x500D8600 GLOBAL_P3_S size 0x200 — GPIO Port 6
0x500D8800 GLOBAL_P4_S size 0x200 — GPIO Port 7
0x500DA000 GLOBAL_GPIOTE20_S size 0x1000 — GPIO Tasks and Events 1
0x500E0000 GLOBAL_QDEC20_S size 0x1000 — Quadrature Decoder 1
0x500E1000 GLOBAL_QDEC21_S size 0x1000 — Quadrature Decoder 3
0x500E2000 GLOBAL_GRTC_S size 0x1000 — Global Real-time counter 1
0x500E8000 GLOBAL_TDM_S size 0x1000 — Time division multiplexed audio interface 1
0x500ED000 GLOBAL_SPIM23_S size 0x1000 — Serial Peripheral Interface Master with EasyDMA 11
0x500ED000 GLOBAL_SPIS23_S size 0x1000 — SPI Slave 11
0x500ED000 GLOBAL_TWIM23_S size 0x1000 — I2C compatible Two-Wire Master Interface with EasyDMA 7
0x500ED000 GLOBAL_TWIS23_S size 0x1000 — I2C compatible Two-Wire Slave Interface with EasyDMA 7
0x500ED000 GLOBAL_UARTE23_S size 0x1000 — UART with EasyDMA 9
0x500EE000 GLOBAL_SPIM24_S size 0x1000 — Serial Peripheral Interface Master with EasyDMA 13
0x500EE000 GLOBAL_SPIS24_S size 0x1000 — SPI Slave 13
0x500EE000 GLOBAL_TWIM24_S size 0x1000 — I2C compatible Two-Wire Master Interface with EasyDMA 9
0x500EE000 GLOBAL_TWIS24_S size 0x1000 — I2C compatible Two-Wire Slave Interface with EasyDMA 9
0x500EE000 GLOBAL_UARTE24_S size 0x1000 — UART with EasyDMA 11
0x500EF000 GLOBAL_TAMPC_S size 0x1000 — Tamper controller
0x500F1000 GLOBAL_COEXC_S size 0x1000 — Coexistence controller 1
0x50100000 GLOBAL_SPU30_S size 0x1000 — System protection unit 3
0x50102000 GLOBAL_DPPIC30_S size 0x1000 — Distributed programmable peripheral interconnect controller 7
0x50103000 GLOBAL_PPIB30_S size 0x1000 — PPIB APB registers 15
0x50104000 GLOBAL_SPIM30_S size 0x1000 — Serial Peripheral Interface Master with EasyDMA 15
0x50104000 GLOBAL_SPIS30_S size 0x1000 — SPI Slave 15
0x50104000 GLOBAL_TWIM30_S size 0x1000 — I2C compatible Two-Wire Master Interface with EasyDMA 11
0x50104000 GLOBAL_TWIS30_S size 0x1000 — I2C compatible Two-Wire Slave Interface with EasyDMA 11
0x50104000 GLOBAL_UARTE30_S size 0x1000 — UART with EasyDMA 13
0x50106000 GLOBAL_COMP_S size 0x1000 — Comparator 1
0x50106000 GLOBAL_LPCOMP_S size 0x1000 — Low-power comparator 1
0x50108000 GLOBAL_WDT30_S size 0x1000 — Watchdog Timer 0
0x50109000 GLOBAL_WDT31_S size 0x1000 — Watchdog Timer 2
0x5010A000 GLOBAL_P0_S size 0x200 — GPIO Port 9
0x5010C000 GLOBAL_GPIOTE30_S size 0x1000 — GPIO Tasks and Events 3
0x5010E000 GLOBAL_CLOCK_S size 0x1000 — Clock management 1
0x5010E000 GLOBAL_POWER_S size 0x1000 — Power control 1
0x5010E000 GLOBAL_RESET_S size 0x1000 — Reset control 1
0x50111000 GLOBAL_GLITCHDET_S size 0x1000 — Voltage glitch detectors
0x50120000 GLOBAL_OSCILLATORS_S size 0x1000 — Oscillator control 1
0x50120000 GLOBAL_REGULATORS_S size 0x1000 — Voltage regulators 1
0x50121000 GLOBAL_VREGUSB_S size 0x1000 — VREGUSB peripheral 1
0x50122000 GLOBAL_LFXO_S size 0x1000 — LFXO peripheral 1
0x50123000 GLOBAL_LFRC_S size 0x1000 — LFRC peripheral 1
0x50124000 GLOBAL_HFXO64M_S size 0x1000 — HFXO64M peripheral 1
0x5012A000 GLOBAL_OSCRFR_S size 0x1000 — OSCRFR peripheral 1
0x50130000 GLOBAL_AUXPLL_S size 0x1000 — AUXPLL 1
0x50130000 GLOBAL_AUXPM_S size 0x1000 — AUXPM 1
0xE0040000 TPIU_NS size 0x1000 — Trace Port Interface Unit
0xE0041000 ETM_NS size 0x1000 — Embedded Trace Macrocell
0xE0080000 CPUC_S size 0x1000 — CPU control
0xE0082000 ICACHE_S size 0x1000 — Cache

## Interrupts
28 SWI00 (SWI00_S)
29 SWI01 (SWI01_S)
30 SWI02 (SWI02_S)
31 SWI03 (SWI03_S)
64 SPU00 (GLOBAL_SPU00_S)
65 MPC00 (GLOBAL_MPC00_S)
67 MPC03 (GLOBAL_MPC03_S)
74 AAR00_CCM00 (GLOBAL_AAR00_NS, GLOBAL_CCM00_NS, GLOBAL_AAR00_S, GLOBAL_CCM00_S)
75 ECB00 (GLOBAL_ECB00_NS, GLOBAL_ECB00_S)
76 VPR00 (GLOBAL_VPR00_NS, GLOBAL_VPR00_S)
77 SERIAL00 (GLOBAL_SPIM00_NS, GLOBAL_SPIS00_NS, GLOBAL_UARTE00_NS, GLOBAL_SPIM00_S, GLOBAL_SPIS00_S, GLOBAL_UARTE00_S)
78 MRAMC (GLOBAL_MRAMC_S)
82 CTRLAP (GLOBAL_CTRLAP_NS, GLOBAL_CTRLAP_S)
85 TIMER00 (GLOBAL_TIMER00_NS, GLOBAL_TIMER00_S)
88 EGU00 (GLOBAL_EGU00_NS, GLOBAL_EGU00_S)
89 CRACEN (GLOBAL_CRACEN_S)
90 USBHS (GLOBAL_USBHS_NS, GLOBAL_USBHS_S)
91 MSPI00 (GLOBAL_MSPI00_NS, GLOBAL_MSPI00_S)
92 MSPI01 (GLOBAL_MSPI01_NS, GLOBAL_MSPI01_S)
93 SERIAL01 (GLOBAL_SPIM01_NS, GLOBAL_SPIS01_NS, GLOBAL_SPIM01_S, GLOBAL_SPIS01_S)
120 BELLBOARD_0 (BELLBOARD_NS)
121 BELLBOARD_1 (BELLBOARD_NS)
128 SPU10 (GLOBAL_SPU10_S)
133 TIMER10 (GLOBAL_TIMER10_NS, GLOBAL_TIMER10_S)
135 EGU10 (GLOBAL_EGU10_NS, GLOBAL_EGU10_S)
138 RADIO_0 (GLOBAL_RADIO_NS, GLOBAL_RADIO_S)
139 RADIO_1 (GLOBAL_RADIO_NS, GLOBAL_RADIO_S)
141 IPCT10_0 (GLOBAL_IPCT10_NS, GLOBAL_IPCT10_S)
142 IPCT10_1 (GLOBAL_IPCT10_NS, GLOBAL_IPCT10_S)
143 IPCT10_2 (GLOBAL_IPCT10_NS, GLOBAL_IPCT10_S)
144 IPCT10_3 (GLOBAL_IPCT10_NS, GLOBAL_IPCT10_S)
192 SPU20 (GLOBAL_SPU20_S)
198 SERIAL20 (GLOBAL_SPIM20_NS, GLOBAL_SPIS20_NS, GLOBAL_TWIM20_NS, GLOBAL_TWIS20_NS, GLOBAL_UARTE20_NS, GLOBAL_SPIM20_S, GLOBAL_SPIS20_S, GLOBAL_TWIM20_S, GLOBAL_TWIS20_S, GLOBAL_UARTE20_S)
199 SERIAL21 (GLOBAL_SPIM21_NS, GLOBAL_SPIS21_NS, GLOBAL_TWIM21_NS, GLOBAL_TWIS21_NS, GLOBAL_UARTE21_NS, GLOBAL_SPIM21_S, GLOBAL_SPIS21_S, GLOBAL_TWIM21_S, GLOBAL_TWIS21_S, GLOBAL_UARTE21_S)
200 SERIAL22 (GLOBAL_SPIM22_NS, GLOBAL_SPIS22_NS, GLOBAL_TWIM22_NS, GLOBAL_TWIS22_NS, GLOBAL_UARTE22_NS, GLOBAL_SPIM22_S, GLOBAL_SPIS22_S, GLOBAL_TWIM22_S, GLOBAL_TWIS22_S, GLOBAL_UARTE22_S)
201 EGU20 (GLOBAL_EGU20_NS, GLOBAL_EGU20_S)
202 TIMER20 (GLOBAL_TIMER20_NS, GLOBAL_TIMER20_S)
203 TIMER21 (GLOBAL_TIMER21_NS, GLOBAL_TIMER21_S)
204 TIMER22 (GLOBAL_TIMER22_NS, GLOBAL_TIMER22_S)
205 TIMER23 (GLOBAL_TIMER23_NS, GLOBAL_TIMER23_S)
206 TIMER24 (GLOBAL_TIMER24_NS, GLOBAL_TIMER24_S)
208 PDM20 (GLOBAL_PDM20_NS, GLOBAL_PDM20_S)
209 PDM21 (GLOBAL_PDM21_NS, GLOBAL_PDM21_S)
210 PWM20 (GLOBAL_PWM20_NS, GLOBAL_PWM20_S)
211 PWM21 (GLOBAL_PWM21_NS, GLOBAL_PWM21_S)
212 PWM22 (GLOBAL_PWM22_NS, GLOBAL_PWM22_S)
213 SAADC (GLOBAL_SAADC_NS, GLOBAL_SAADC_S)
214 NFCT (GLOBAL_NFCT_NS, GLOBAL_NFCT_S)
215 TEMP (GLOBAL_TEMP_NS, GLOBAL_TEMP_S)
218 GPIOTE20_0 (GLOBAL_GPIOTE20_NS, GLOBAL_GPIOTE20_S)
219 GPIOTE20_1 (GLOBAL_GPIOTE20_NS, GLOBAL_GPIOTE20_S)
224 QDEC20 (GLOBAL_QDEC20_NS, GLOBAL_QDEC20_S)
225 QDEC21 (GLOBAL_QDEC21_NS, GLOBAL_QDEC21_S)
226 GRTC_0 (GLOBAL_GRTC_NS, GLOBAL_GRTC_S)
227 GRTC_1 (GLOBAL_GRTC_NS, GLOBAL_GRTC_S)
228 GRTC_2 (GLOBAL_GRTC_NS, GLOBAL_GRTC_S)
229 GRTC_3 (GLOBAL_GRTC_NS, GLOBAL_GRTC_S)
230 GRTC_4 (GLOBAL_GRTC_NS, GLOBAL_GRTC_S)
231 GRTC_5 (GLOBAL_GRTC_NS, GLOBAL_GRTC_S)
232 TDM (GLOBAL_TDM_NS, GLOBAL_TDM_S)
237 SERIAL23 (GLOBAL_SPIM23_NS, GLOBAL_SPIS23_NS, GLOBAL_TWIM23_NS, GLOBAL_TWIS23_NS, GLOBAL_UARTE23_NS, GLOBAL_SPIM23_S, GLOBAL_SPIS23_S, GLOBAL_TWIM23_S, GLOBAL_TWIS23_S, GLOBAL_UARTE23_S)
238 SERIAL24 (GLOBAL_SPIM24_NS, GLOBAL_SPIS24_NS, GLOBAL_TWIM24_NS, GLOBAL_TWIS24_NS, GLOBAL_UARTE24_NS, GLOBAL_SPIM24_S, GLOBAL_SPIS24_S, GLOBAL_TWIM24_S, GLOBAL_TWIS24_S, GLOBAL_UARTE24_S)
239 TAMPC (GLOBAL_TAMPC_S)
256 SPU30 (GLOBAL_SPU30_S)
260 SERIAL30 (GLOBAL_SPIM30_NS, GLOBAL_SPIS30_NS, GLOBAL_TWIM30_NS, GLOBAL_TWIS30_NS, GLOBAL_UARTE30_NS, GLOBAL_SPIM30_S, GLOBAL_SPIS30_S, GLOBAL_TWIM30_S, GLOBAL_TWIS30_S, GLOBAL_UARTE30_S)
262 COMP_LPCOMP (GLOBAL_COMP_NS, GLOBAL_LPCOMP_NS, GLOBAL_COMP_S, GLOBAL_LPCOMP_S)
264 WDT30 (GLOBAL_WDT30_S)
265 WDT31 (GLOBAL_WDT31_NS, GLOBAL_WDT31_S)
268 GPIOTE30_0 (GLOBAL_GPIOTE30_NS, GLOBAL_GPIOTE30_S)
269 GPIOTE30_1 (GLOBAL_GPIOTE30_NS, GLOBAL_GPIOTE30_S)
270 CLOCK_POWER (GLOBAL_CLOCK_NS, GLOBAL_POWER_NS, GLOBAL_CLOCK_S, GLOBAL_POWER_S)
289 VREGUSB (GLOBAL_VREGUSB_NS, GLOBAL_VREGUSB_S)
290 LFXO (GLOBAL_LFXO_NS, GLOBAL_LFXO_S)
291 LFRC (GLOBAL_LFRC_NS, GLOBAL_LFRC_S)
292 HFXO64M (GLOBAL_HFXO64M_NS, GLOBAL_HFXO64M_S)
304 AUXPLL_AUXPM (GLOBAL_AUXPLL_NS, GLOBAL_AUXPM_NS, GLOBAL_AUXPLL_S, GLOBAL_AUXPM_S)

## Further device data
MaxInterrupts=480

## Licence text in the file
Copyright (c) 2010 - 2026, Nordic Semiconductor ASA All rights reserved. SPDX-License-Identifier: BSD-3-Clause Redistribution and use in source and binary forms, with or without modification, are permitted provided that the following conditions are met: 1. Redistributions of source code must retain the above copyright notice, this list of conditions and the following disclaimer. 2. Redistributions in binary form must reproduce the above copyright notice, this list of conditions and the following disclaimer in the documentation and/or other materials provided with the distribution. 3. Neither the name of Nordic Semiconductor ASA nor the names of its contributors may be used to endorse or promote products derived from this software without specific prior written permission. THIS SOFTWARE IS PROVIDED BY THE COPYRIGHT HOLDERS AND CONTRIBUTORS "AS IS" AND ANY EXPRESS OR IMPLIED WARRANTIES, INCLUDING, BUT NOT LIMITED TO, THE IMPLIED WARRANTIES OF MERCHANTABILITY, AND FITNESS FOR A PARTICULAR PURPOSE ARE DISCLAIMED. IN NO EVENT SHALL NORDIC SEMICONDUCTOR ASA OR CONTRIBUTORS BE LIABLE FOR ANY DIRECT, INDIRECT, INCIDENTAL, SPECIAL, EXEMPLARY, OR CONSEQUENTIAL DAMAGES (INCLUDING, BUT NOT LIMITED TO, PROCUREMENT OF SUBSTITUTE GOODS OR SERVICES; LOSS OF USE, DATA, OR PROFITS; OR BUSINESS INTERRUPTION) HOWEVER CAUSED AND ON ANY THEORY OF LIABILITY, WHETHER IN CONTRACT, STRICT LIABILITY, OR TORT (INCLUDING NEGLIGENCE OR OTHERWISE) ARISING IN ANY WAY OUT OF THE USE OF THIS SOFTWARE, EVEN IF ADVISED OF THE POSSIBILITY OF SUCH DAMAGE.
